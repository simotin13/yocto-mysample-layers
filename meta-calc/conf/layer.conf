## meta-calc/conf/layer.conf
```bitbake
# We have a conf and classes directory, add to BBPATH
BBPATH .= ":${LAYERDIR}"

# We have recipes-* directories, add to BBFILES
BBFILES += "${LAYERDIR}/recipes-*/*/*.bb \
            ${LAYERDIR}/recipes-*/*/*.bbappend"

BBFILE_COLLECTIONS += "meta-calc"
BBFILE_PATTERN_meta-calc = "^${LAYERDIR}/"
BBFILE_PRIORITY_meta-calc = "6"

LAYERDEPENDS_meta-calc = "core"
LAYERSERIES_COMPAT_meta-calc = "warrior zeus"
```
